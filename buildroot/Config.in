## buildroot/Config.in
```kconfig
# Top-level Config.in for the fos-next external tree.
source "$BR2_EXTERNAL_FOS_NEXT_PATH/package/fos-agent/Config.in"
```

## buildroot/configs/fsx64_defconfig
```kconfig
# fos-next x86_64 Buildroot defconfig
# Target: x86_64 only (ARM64 dropped per plan decisions)
# Buildroot version: 2025.02.4

BR2_x86_64=y
BR2_x86_nocona=y

# Toolchain — use musl for a smaller rootfs
BR2_TOOLCHAIN_BUILDROOT_MUSL=y
BR2_TOOLCHAIN_BUILDROOT_CXX=y

# System
BR2_TARGET_GENERIC_HOSTNAME="fogclient.localdomain"
BR2_TARGET_GENERIC_ISSUE="fos-next - FOG Imaging OS"
BR2_INIT_BUSYBOX=y
BR2_SYSTEM_BIN_SH_BUSYBOX=y
BR2_TARGET_OPTIMIZATION="-Os -pipe"
BR2_ROOTFS_DEVICE_CREATION_DYNAMIC_EUDEV=y
BR2_ROOTFS_OVERLAY="$(BR2_EXTERNAL_FOS_NEXT_PATH)/board/fos-next/rootfs_overlay"

# Compression
BR2_TARGET_ROOTFS_CPIO=y
BR2_TARGET_ROOTFS_CPIO_XZ=y

# Kernel headers — must match the kernel version being built
BR2_TOOLCHAIN_HEADERS_AT_LEAST="6.18"
BR2_DEFAULT_KERNEL_HEADERS="6.18.22"
BR2_KERNEL_HEADERS_6_18=y
BR2_PACKAGE_LINUX_HEADERS=y

# Kernel
BR2_LINUX_KERNEL=y
BR2_LINUX_KERNEL_CUSTOM_VERSION=y
BR2_LINUX_KERNEL_CUSTOM_VERSION_VALUE="6.18.22"
BR2_LINUX_KERNEL_DEFCONFIG="x86_64"
BR2_LINUX_KERNEL_CONFIG_FRAGMENT_FILES="$(BR2_EXTERNAL_FOS_NEXT_PATH)/board/fos-next/kernel-patches/kernel.config"
BR2_LINUX_KERNEL_IMAGE_TARGET_CUSTOM=y
BR2_LINUX_KERNEL_IMAGE_TARGET_NAME="bzImage"
BR2_LINUX_KERNEL_NEEDS_HOST_OPENSSL=y

# Host Go toolchain (needed to build fos-agent)
BR2_PACKAGE_HOST_GO_TARGET_ARCH_SUPPORTS=y

# ── Core packages ────────────────────────────────────────────────────────────

# BusyBox (shell + core utils)
BR2_PACKAGE_BUSYBOX=y
BR2_PACKAGE_BUSYBOX_CONFIG="$(BR2_EXTERNAL_FOS_NEXT_PATH)/package/busybox/busybox.config"

# Imaging engine
BR2_PACKAGE_PARTCLONE=y

# Partition management
BR2_PACKAGE_PARTED=y
BR2_PACKAGE_GPT_FDISK=y

# Filesystems
BR2_PACKAGE_NTFS_3G=y
BR2_PACKAGE_NTFS_3G_NTFSPROGS=y
BR2_PACKAGE_E2FSPROGS=y
BR2_PACKAGE_XFSPROGS=y

# Compression
BR2_PACKAGE_XZ=y
BR2_PACKAGE_ZSTD=y

# Networking
BR2_PACKAGE_UTIL_LINUX=y
BR2_PACKAGE_UTIL_LINUX_LIBS=y
BR2_PACKAGE_UTIL_LINUX_LIBBLKID=y
BR2_PACKAGE_UTIL_LINUX_BINARIES=y

# Debug SSH access
BR2_PACKAGE_DROPBEAR=y

# fos-agent (the PID 1 imaging agent)
BR2_PACKAGE_FOS_AGENT=y

# ── Explicitly excluded ───────────────────────────────────────────────────────
# nfs-utils — dropped: HTTP replaces NFS for image transfers
# partimage  — superseded by partclone
# chntpw     — dropped
# cabextract  — dropped
# photorec   — dropped
# testdisk   — dropped
```

## buildroot/package/fos-agent/Config.in
```kconfig
config BR2_PACKAGE_FOS_AGENT
	bool "fos-agent"
	depends on BR2_x86_64
	depends on BR2_PACKAGE_HOST_GO_TARGET_ARCH_SUPPORTS
	help
	  fos-agent is the PID 1 imaging agent for the fos-next initramfs.
	  It communicates with fog-next's boot API to register hosts,
	  deploy images, capture images, and perform disk wipes.

	  https://github.com/nemvince/fos-next

if BR2_PACKAGE_FOS_AGENT

config BR2_PACKAGE_FOS_AGENT_VERSION
	string "fos-agent source version/tag"
	default "main"

config BR2_PACKAGE_FOS_AGENT_SITE
	string "fos-agent source path (local)"
	default "$(BR2_EXTERNAL)/../../agent"
	help
	  Path to the agent Go module source tree.
	  Defaults to the sibling agent/ directory inside the fos-next repo.

endif
```

## buildroot/package/partclone/Config.in
```kconfig
config BR2_PACKAGE_PARTCLONE
	bool "partclone"
	depends on BR2_USE_WCHAR
	help
	  Partclone — partition imaging and cloning tool.
	  Provides partclone.ext4, partclone.ntfs, partclone.fat,
	  partclone.xfs, partclone.btrfs and partclone.dd.

	  http://partclone.org

comment "partclone requires a toolchain with WCHAR support"
	depends on !BR2_USE_WCHAR
```
